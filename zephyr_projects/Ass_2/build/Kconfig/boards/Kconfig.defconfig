## zephyr_projects/Ass_2/build/Kconfig/boards/Kconfig.defconfig
```kconfig
# Load Zephyr board defconfig descriptions.
osource "/home/girish/Zephyr-Development-STM32/zephyr/boards/others/rugged_board/Kconfig.defconfig"
```

## zephyr_projects/Ass_2/build/Kconfig/boards/Kconfig.rugged_board
```kconfig
# Load board Kconfig descriptions.
osource "/home/girish/Zephyr-Development-STM32/zephyr/boards/others/rugged_board/Kconfig.rugged_board"
```

## zephyr_projects/Ass_5/build/Kconfig/boards/Kconfig.gan_board
```kconfig
# Load board Kconfig descriptions.
osource "/home/girish/Zephyr-Development-STM32/zephyr/boards/others/gan_board/Kconfig.gan_board"
```

## zephyr_projects/Ass_7/build/Kconfig/arch/Kconfig
```kconfig
# Load Zephyr Arch Kconfig descriptions.
osource "/home/girish/Zephyr-Development-STM32/zephyr/arch/rx/Kconfig"
osource "/home/girish/Zephyr-Development-STM32/zephyr/arch/x86/Kconfig"
osource "/home/girish/Zephyr-Development-STM32/zephyr/arch/xtensa/Kconfig"
osource "/home/girish/Zephyr-Development-STM32/zephyr/arch/sparc/Kconfig"
osource "/home/girish/Zephyr-Development-STM32/zephyr/arch/riscv/Kconfig"
osource "/home/girish/Zephyr-Development-STM32/zephyr/arch/posix/Kconfig"
osource "/home/girish/Zephyr-Development-STM32/zephyr/arch/mips/Kconfig"
osource "/home/girish/Zephyr-Development-STM32/zephyr/arch/arm64/Kconfig"
osource "/home/girish/Zephyr-Development-STM32/zephyr/arch/arm/Kconfig"
osource "/home/girish/Zephyr-Development-STM32/zephyr/arch/arc/Kconfig"
```

## zephyr_projects/BMP_sensor/bme280/build/Kconfig/boards/Kconfig.defconfig
```kconfig
# Load Zephyr board defconfig descriptions.
osource "/home/girish/Zephyr-Development-STM32/zephyr/boards/st/nucleo_f446re/Kconfig.defconfig"
```

## zephyr_projects/BMP_sensor/bme280/build/Kconfig/boards/Kconfig.nucleo_f446re
```kconfig
# Load board Kconfig descriptions.
osource "/home/girish/Zephyr-Development-STM32/zephyr/boards/st/nucleo_f446re/Kconfig.nucleo_f446re"
```

## zephyr_projects/BMP_sensor/bme280/build/Kconfig/boards/Kconfig.sysbuild
```kconfig
# Load Sysbuild board Kconfig descriptions.
osource "/home/girish/Zephyr-Development-STM32/zephyr/boards/st/nucleo_f446re/Kconfig.sysbuild"
```

## zephyr_projects/multi_led/build/Kconfig/boards/Kconfig
```kconfig
# Load Zephyr board Kconfig descriptions.
osource "/home/girish/Zephyr-Development-STM32/zephyr/boards/others/gan_board/Kconfig"
config BOARD_REVISION_1_1_0
	def_bool y
```
